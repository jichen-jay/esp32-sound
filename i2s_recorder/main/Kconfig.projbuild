## i2s_recorder/main/Kconfig.projbuild
```kconfig
menu "T-Embed I2S Recorder Configuration"

    config EXAMPLE_BIT_SAMPLE
        int "Audio Bit Sample"
        default 16
        help
            Define the number of bits for each sample. Default 16 bits per sample.

    config EXAMPLE_FORMAT_IF_MOUNT_FAILED
        bool "Format SD card if mount failed"
        default y
        help
            Format the SD card if mounting fails.

    config T_EMBED_MIC_CLK_GPIO
        int "T-Embed Microphone Clock GPIO"
        default 39
        help
            GPIO pin for microphone clock signal on T-Embed.

    config T_EMBED_MIC_DATA_GPIO
        int "T-Embed Microphone Data GPIO"
        default 42
        help
            GPIO pin for microphone data signal on T-Embed.

    config T_EMBED_SD_CS_GPIO
        int "T-Embed SD Card CS GPIO"
        default 13
        help
            GPIO pin for SD card chip select on T-Embed.

    config T_EMBED_SPI_MOSI_GPIO
        int "T-Embed SPI MOSI GPIO"
        default 9
        help
            GPIO pin for SPI MOSI on T-Embed.

    config T_EMBED_SPI_MISO_GPIO
        int "T-Embed SPI MISO GPIO"
        default 10
        help
            GPIO pin for SPI MISO on T-Embed.

    config T_EMBED_SPI_CLK_GPIO
        int "T-Embed SPI Clock GPIO"
        default 11
        help
            GPIO pin for SPI clock on T-Embed.

endmenu
```

## i2s_recorder/sdkconfig.defaults
```kconfig
# T-Embed WAV Player Configuration
CONFIG_I2S_ENABLE_DEBUG_LOG=y
CONFIG_FREERTOS_HZ=1000

# ESP32-S3 specific configurations
CONFIG_IDF_TARGET="esp32s3"
CONFIG_IDF_TARGET_ESP32S3=y

# ESP32-S3 Memory Configuration
CONFIG_ESP32S3_DEFAULT_CPU_FREQ_240=y
CONFIG_ESP32S3_DEFAULT_CPU_FREQ_MHZ=240
CONFIG_ESP_DEFAULT_CPU_FREQ_MHZ_240=y
CONFIG_ESP_DEFAULT_CPU_FREQ_MHZ=240

# Flash and Memory Settings for ESP32-S3
CONFIG_ESPTOOLPY_FLASHSIZE_16MB=y
CONFIG_ESPTOOLPY_FLASHSIZE="16MB"
CONFIG_ESPTOOLPY_FLASHMODE_QIO=y
CONFIG_ESPTOOLPY_FLASHMODE="qio"
CONFIG_ESPTOOLPY_FLASHFREQ_80M=y
CONFIG_ESPTOOLPY_FLASHFREQ="80m"

# Partition Table
CONFIG_PARTITION_TABLE_SINGLE_APP=y
CONFIG_PARTITION_TABLE_FILENAME="partitions_singleapp.csv"

# Memory allocation for ESP32-S3
CONFIG_ESP32S3_SPIRAM_SUPPORT=y
CONFIG_SPIRAM=y
CONFIG_SPIRAM_MODE_OCT=y
CONFIG_SPIRAM_TYPE_AUTO=y
CONFIG_SPIRAM_SIZE=8388608
CONFIG_SPIRAM_SPEED_80M=y
CONFIG_SPIRAM_USE_MALLOC=y
CONFIG_SPIRAM_MALLOC_ALWAYSINTERNAL=16384
CONFIG_SPIRAM_MALLOC_RESERVE_INTERNAL=32768

# Enable debugging
CONFIG_ESP_CONSOLE_UART_DEFAULT=y
CONFIG_ESP_CONSOLE_UART_BAUDRATE=115200
CONFIG_LOG_DEFAULT_LEVEL_INFO=y
CONFIG_LOG_MAXIMUM_LEVEL=3

# Bootloader configuration
CONFIG_BOOTLOADER_COMPILER_OPTIMIZATION_SIZE=y
CONFIG_BOOTLOADER_LOG_LEVEL_INFO=y

# Build type configuration
CONFIG_APP_BUILD_TYPE_APP_2NDBOOT=y
CONFIG_APP_BUILD_GENERATE_BINARIES=y
CONFIG_APP_BUILD_BOOTLOADER=y
CONFIG_APP_BUILD_USE_FLASH_SECTIONS=y

# Audio configuration
CONFIG_SOC_I2S_SUPPORTS_PDM_RX=y
CONFIG_SOC_I2S_SUPPORTS_ADC=y
```
